## prj.conf
```kconfig
# C++
CONFIG_CPP=y
CONFIG_STD_CPP2B=y
CONFIG_GLIBCXX_LIBCPP=y

CONFIG_MAIN_STACK_SIZE=2048

# Shell on the console UART
CONFIG_SHELL=y
CONFIG_SHELL_BACKEND_SERIAL=y
CONFIG_SHELL_VT100_COLORS=n
CONFIG_MCUBOOT_SHELL=y

# MCUmgr (SMP) over the shell transport, so the shell and mcumgr share one UART
CONFIG_NET_BUF=y
CONFIG_ZCBOR=y
CONFIG_CRC=y
CONFIG_BASE64=y
CONFIG_MCUMGR=y
CONFIG_MCUMGR_TRANSPORT_SHELL=y
CONFIG_MCUMGR_GRP_IMG=y
CONFIG_MCUMGR_GRP_OS=y

CONFIG_FLASH=y
CONFIG_FLASH_MAP=y
CONFIG_STREAM_FLASH=y
CONFIG_IMG_MANAGER=y

# Off so printk goes straight to the UART and no log output mixes into the SMP stream
CONFIG_LOG=n
```

## src/main.cpp
```c
#include <zephyr/kernel.h>

#ifndef FIRMWARE_VERSION
#define FIRMWARE_VERSION "OLD"
#endif

int main()
{
    printk("Hello World! - %s FIRMWARE - %s\n", FIRMWARE_VERSION, CONFIG_BOARD_TARGET);
    return 0;
}
```
